## sdkconfig.defaults
```kconfig
# Enable FreeRTOS run-time stats
CONFIG_FREERTOS_GENERATE_RUN_TIME_STATS=y
CONFIG_FREERTOS_USE_STATS_FORMATTING_FUNCTIONS=y
CONFIG_FREERTOS_RUN_TIME_COUNTER_TYPE=1
```
